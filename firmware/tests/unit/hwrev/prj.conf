## CMakeLists.txt
```
# Copyright 2026 The ChromiumOS Authors
# Use of this source code is governed by a BSD-style license that can be
# found in the LICENSE file.

cmake_minimum_required(VERSION 3.20.0)
find_package(Zephyr REQUIRED HINTS $ENV{ZEPHYR_BASE})
project(mux_test)

target_sources(app PRIVATE src/main.c)
target_sources(app PRIVATE ../../../src/hwrev.c)
target_include_directories(app PRIVATE ../../../src)
```

## Kconfig
```
# Copyright 2026 The ChromiumOS Authors
# Use of this source code is governed by a BSD-style license that can be
# found in the LICENSE file.

config HWREV_VALUE
    int "hwrev value"
    default 7

source "Kconfig.zephyr"
```

## prj.conf
```kconfig
# Copyright 2026 The ChromiumOS Authors
# Use of this source code is governed by a BSD-style license that can be
# found in the LICENSE file.

CONFIG_ZTEST=y
CONFIG_GPIO=y
CONFIG_KERNEL_INIT_PRIORITY_DEFAULT=99
```

## boards/native_sim.overlay
```dts
/* Copyright 2026 The ChromiumOS Authors
 * Use of this source code is governed by a BSD-style license that can be
 * found in the LICENSE file.
 */

#include <zephyr/dt-bindings/gpio/gpio.h>

/ {
	gpioemu: gpioemu {
		compatible = "zephyr,gpio-emul";
		status = "okay";
		#gpio-cells = <0x2>;
		gpio-controller;
	};

	hwrev {
		compatible = "google,maui-hwrev";
		status = "okay";
		gpios = <&gpioemu 0 GPIO_ACTIVE_HIGH>,
				<&gpioemu 1 GPIO_ACTIVE_HIGH>,
				<&gpioemu 2 GPIO_ACTIVE_HIGH>;
	};
};
```

## src/main.c
```c
/* Copyright 2026 The ChromiumOS Authors
 * Use of this source code is governed by a BSD-style license that can be
 * found in the LICENSE file.
 */

#include "hwrev.h"

#include <zephyr/drivers/gpio/gpio_emul.h>
#include <zephyr/kernel.h>
#include <zephyr/ztest.h>

const struct device *gpio_emul = DEVICE_DT_GET(DT_NODELABEL(gpioemu));

static int test_init()
{
	gpio_pin_configure(gpio_emul, 0, GPIO_INPUT);
	gpio_pin_configure(gpio_emul, 1, GPIO_INPUT);
	gpio_pin_configure(gpio_emul, 2, GPIO_INPUT);

	gpio_emul_input_set(gpio_emul, 0, !!(CONFIG_HWREV_VALUE & BIT(0)));
	gpio_emul_input_set(gpio_emul, 1, !!(CONFIG_HWREV_VALUE & BIT(1)));
	gpio_emul_input_set(gpio_emul, 2, !!(CONFIG_HWREV_VALUE & BIT(2)));

	return 0;
}

SYS_INIT(test_init, POST_KERNEL, 98);

ZTEST(suite_hwrev, test_value_is_cached)
{
	zassert_equal(hwrev_read(), CONFIG_HWREV_VALUE);

	// Check if value was cached at boot-up
	gpio_emul_input_set(gpio_emul, 0, !(CONFIG_HWREV_VALUE & BIT(0)));
	gpio_emul_input_set(gpio_emul, 1, !(CONFIG_HWREV_VALUE & BIT(1)));
	gpio_emul_input_set(gpio_emul, 2, !(CONFIG_HWREV_VALUE & BIT(2)));

	zassert_equal(hwrev_read(), CONFIG_HWREV_VALUE);
}

ZTEST_SUITE(suite_hwrev, NULL, NULL, NULL, NULL, NULL);
```
