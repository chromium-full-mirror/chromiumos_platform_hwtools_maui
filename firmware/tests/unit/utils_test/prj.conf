## CMakeLists.txt
```
# Copyright 2025 The ChromiumOS Authors
# Use of this source code is governed by a BSD-style license that can be
# found in the LICENSE file.

cmake_minimum_required(VERSION 3.20.0)
find_package(Zephyr REQUIRED HINTS $ENV{ZEPHYR_BASE})
project(utils_test)

target_sources(app PRIVATE src/main.c)
target_sources(app PRIVATE ../../../src/utils.c)
target_include_directories(app PRIVATE ../../../src)
```

## prj.conf
```kconfig
# Copyright 2025 The ChromiumOS Authors
# Use of this source code is governed by a BSD-style license that can be
# found in the LICENSE file.

CONFIG_ZTEST=y
```

## src/main.c
```c
/* Copyright 2025 The ChromiumOS Authors
 * Use of this source code is governed by a BSD-style license that can be
 * found in the LICENSE file.
 */

#include "utils.h"

#include <zephyr/ztest.h>

ZTEST(utils_suite, test_add)
{
	zassert_equal(utils_add(2, 3), 5, "2 + 3 should equal 5");
	zassert_equal(utils_add(-1, 1), 0, "-1 + 1 should equal 0");
}

ZTEST_SUITE(utils_suite, NULL, NULL, NULL, NULL, NULL);
```
